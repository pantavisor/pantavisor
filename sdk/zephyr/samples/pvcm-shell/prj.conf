## CMakeLists.txt
```
cmake_minimum_required(VERSION 3.20.0)
find_package(Zephyr REQUIRED HINTS $ENV{ZEPHYR_BASE})
project(pvcm-shell)

target_sources(app PRIVATE src/main.c)

if(CONFIG_OPENAMP)
  zephyr_compile_definitions(METAL_MAX_DEVICE_REGIONS=2)
  target_include_directories(app PRIVATE
    ${LIBMETAL_INCLUDE_DIR}
    ${OPENAMP_INCLUDE_DIR}
    ${PLATFORM_DIR}
  )
  target_sources(app PRIVATE src/shell_rpmsg.c)
endif()
```

## prj.conf
```kconfig
CONFIG_PRINTK=y
CONFIG_LOG=y
CONFIG_LOG_DEFAULT_LEVEL=3
CONFIG_IPM=y
CONFIG_HEAP_MEM_POOL_SIZE=1024
CONFIG_OPENAMP=y
CONFIG_OPENAMP_RSC_TABLE_NUM_RPMSG_BUFF=32
CONFIG_OPENAMP_RSC_TABLE=y
CONFIG_OPENAMP_MASTER=n
CONFIG_SHELL=y

# Pantavisor MCU SDK
CONFIG_PANTAVISOR=y
CONFIG_PANTAVISOR_TRANSPORT_RPMSG=y
CONFIG_PANTAVISOR_LOG_BACKEND=y
CONFIG_PANTAVISOR_SHELL=y
CONFIG_PANTAVISOR_BRIDGE=y
CONFIG_PANTAVISOR_DBUS=y
```

## boards/mimx8mn_evk.conf
```kconfig
# i.MX8M Nano M7 — RPMsg transport via OpenAMP over remoteproc
CONFIG_OPENAMP=y
CONFIG_OPENAMP_MASTER=n
CONFIG_IPM=y
CONFIG_IPM_IMX=y
CONFIG_OPENAMP_RSC_TABLE=y
CONFIG_OPENAMP_RSC_TABLE_NUM_RPMSG_BUFF=32

# MU register mapping: 4 bytes per register = 4 independent channels.
# Linux DTB uses mbox index 1, so M7 must monitor RR[1].
# With SIZE_16 (default), only RR[3] is monitored — misses the kick.
CONFIG_IPM_IMX_MAX_DATA_SIZE_16=n
CONFIG_IPM_IMX_MAX_DATA_SIZE_4=y
```

## boards/native_posix_64.conf
```kconfig
# Override for native_posix: use UART transport instead of RPMsg
# (native_posix has no OpenAMP/RPMsg support)
CONFIG_PANTAVISOR_TRANSPORT_RPMSG=n
CONFIG_PANTAVISOR_TRANSPORT_UART=y
CONFIG_OPENAMP=n
CONFIG_SERIAL=y
CONFIG_UART_NATIVE_POSIX=y
```

## boards/native_sim_64.conf
```kconfig
# Override for native_sim: use UART transport instead of RPMsg
CONFIG_PANTAVISOR_TRANSPORT_RPMSG=n
CONFIG_PANTAVISOR_TRANSPORT_UART=y
CONFIG_OPENAMP=n
CONFIG_SERIAL=y
CONFIG_UART_NATIVE_POSIX=y
# UART0 = shell/console (default PTY or stdin/stdout)
# UART1 = PVCM protocol (own PTY, bidirectional)
CONFIG_UART_NATIVE_POSIX_PORT_1_ENABLE=y
CONFIG_PANTAVISOR_UART_DEVICE="uart_1"
# Enable HTTP bridge for testing
CONFIG_PANTAVISOR_BRIDGE=y
# Slow simulated time to match wall clock for UART I/O
CONFIG_NATIVE_SIM_SLOWDOWN_TO_REAL_TIME=y
```

## src/main.c
```c
/*
 * PVCM Shell — MCU firmware with protocol + shell channels.
 *
 * On RPMsg (i.MX8MN):
 *   Channel 0 (ttyRPMSG0): Zephyr debug shell
 *   Channel 1 (ttyRPMSG1): PVCM protocol (heartbeat, HTTP/D-Bus gateway)
 *
 * On native_sim:
 *   uart0: console/shell
 *   uart_1: PVCM protocol (PTY)
 *
 * SPDX-License-Identifier: Apache-2.0
 */

#include <zephyr/kernel.h>
#include <zephyr/device.h>
#include <string.h>
#include <stdio.h>

#include <zephyr/logging/log.h>
LOG_MODULE_REGISTER(pvcm_main, LOG_LEVEL_DBG);

#include <pantavisor/pvcm.h>
#ifdef CONFIG_PANTAVISOR_FS
#include <pantavisor/pvcm_fs.h>
#endif
#include <pantavisor/pvcm_protocol.h>

#ifdef CONFIG_OPENAMP
/*
 * RPMsg platform — OpenAMP + remoteproc on real hardware.
 * Two RPMsg channels: shell + PVCM protocol.
 */

#include <zephyr/drivers/ipm.h>
#include <openamp/open_amp.h>
#include <metal/device.h>
#include <resource_table.h>
#include "shell_rpmsg.h"

/* PVCM transport hooks (from pvcm_transport_rpmsg.c) */
extern int pvcm_rpmsg_rx_cb(struct rpmsg_endpoint *ept, void *data,
			    size_t len, uint32_t src, void *priv);
extern void pvcm_rpmsg_set_endpoint(struct rpmsg_endpoint *ept);

#define SHM_DEVICE_NAME	"shm"

#if !DT_HAS_CHOSEN(zephyr_ipc_shm)
#error "Requires 'zephyr,ipc-shm' in chosen"
#endif

#define SHM_NODE	DT_CHOSEN(zephyr_ipc_shm)
#define SHM_START_ADDR	DT_REG_ADDR(SHM_NODE)
#define SHM_SIZE	DT_REG_SIZE(SHM_NODE)

#define APP_TASK_STACK_SIZE (1024)

K_THREAD_STACK_DEFINE(thread_mng_stack, APP_TASK_STACK_SIZE);

static struct k_thread thread_mng_data;

static const struct device *const ipm_handle =
	DEVICE_DT_GET(DT_CHOSEN(zephyr_ipc));

static metal_phys_addr_t shm_physmap = SHM_START_ADDR;

struct metal_device shm_device = {
	.name = SHM_DEVICE_NAME,
	.num_regions = 2,
	.regions = {
		{.virt = NULL}, /* shared memory */
		{.virt = NULL}, /* rsc_table memory */
	},
	.node = { NULL },
	.irq_num = 0,
	.irq_info = NULL
};

static struct metal_io_region *shm_io;
static struct rpmsg_virtio_shm_pool shpool;
static struct metal_io_region *rsc_io;
static struct rpmsg_virtio_device rvdev;

static void *rsc_table;
static struct rpmsg_device *rpdev;

/* protocol channel endpoint */
static struct rpmsg_endpoint proto_ept;

static K_SEM_DEFINE(data_sem, 0, 1);

static void platform_ipm_callback(const struct device *dev, void *context,
				  uint32_t id, volatile void *data)
{
	k_sem_give(&data_sem);
}

static void receive_message(void)
{
	/*
	 * Poll with short timeout instead of blocking forever.
	 * The Linux→M7 MU kick (TYPE_TX) can time out if the M7
	 * doesn't read MU RR[1] quickly enough. By polling, we
	 * process vring data even when the kick notification is lost.
	 */
	/* Poll with short timeout — the MU kick from Linux can fail
	 * with ETIME, so we must poll the vring periodically */
	k_sem_take(&data_sem, K_MSEC(50));
	rproc_virtio_notified(rvdev.vdev, VRING1_ID);
}

static void new_service_cb(struct rpmsg_device *rdev, const char *name,
			   uint32_t src)
{
	LOG_ERR("unexpected ns service: %s", name);
}

/*
 * Linux DTB: tx = <&mu 0 1>, rx = <&mu 1 1>
 * With DATA_SIZE_4, ipm_send id=N writes to MU_B TR[N].
 * Must use id=1 to reach Linux's RX at MU register index 1.
 */
#define MU_TX_IPM_ID 1

int mailbox_notify(void *priv, uint32_t id)
{
	ARG_UNUSED(priv);
	ipm_send(ipm_handle, 0, MU_TX_IPM_ID, NULL, 0);
	return 0;
}

int platform_init(void)
{
	void *rsc_tab_addr;
	int rsc_size;
	struct metal_device *device;
	struct metal_init_params metal_params = METAL_INIT_DEFAULTS;
	int status;

	/*
	 * Zero shared memory to clear stale vrings from any previous run.
	 */
	memset((void *)SHM_START_ADDR, 0, SHM_SIZE);

	status = metal_init(&metal_params);
	if (status) {
		LOG_ERR("metal_init failed: %d", status);
		return -1;
	}

	status = metal_register_generic_device(&shm_device);
	if (status) {
		LOG_ERR("metal_register failed: %d", status);
		return -1;
	}

	status = metal_device_open("generic", SHM_DEVICE_NAME, &device);
	if (status) {
		LOG_ERR("metal_device_open failed: %d", status);
		return -1;
	}

	metal_io_init(&device->regions[0], (void *)SHM_START_ADDR, &shm_physmap,
		      SHM_SIZE, -1, 0, NULL);
	shm_io = metal_device_io_region(device, 0);
	if (!shm_io) {
		LOG_ERR("failed to get shm_io");
		return -1;
	}

	rsc_table_get(&rsc_tab_addr, &rsc_size);
	rsc_table = (struct st_resource_table *)rsc_tab_addr;

	metal_io_init(&device->regions[1], rsc_table,
		      (metal_phys_addr_t *)rsc_table, rsc_size, -1, 0, NULL);
	rsc_io = metal_device_io_region(device, 1);
	if (!rsc_io) {
		LOG_ERR("failed to get rsc_io");
		return -1;
	}

	if (!device_is_ready(ipm_handle)) {
		LOG_ERR("IPM device not ready");
		return -1;
	}

	ipm_register_callback(ipm_handle, platform_ipm_callback, NULL);

	status = ipm_set_enabled(ipm_handle, 1);
	if (status) {
		LOG_ERR("ipm_set_enabled failed: %d", status);
		return -1;
	}

	return 0;
}

struct rpmsg_device *
platform_create_rpmsg_vdev(void)
{
	struct fw_rsc_vdev_vring *vring_rsc;
	struct virtio_device *vdev;
	int ret;

	vdev = rproc_virtio_create_vdev(VIRTIO_DEV_DEVICE, VDEV_ID,
					rsc_table_to_vdev(rsc_table),
					rsc_io, NULL, mailbox_notify, NULL);
	if (!vdev) {
		LOG_ERR("failed to create vdev");
		return NULL;
	}

	rproc_virtio_wait_remote_ready(vdev);

	vring_rsc = rsc_table_get_vring0(rsc_table);
	ret = rproc_virtio_init_vring(vdev, 0, vring_rsc->notifyid,
				      (void *)vring_rsc->da, rsc_io,
				      vring_rsc->num, vring_rsc->align);
	if (ret) {
		LOG_ERR("failed to init vring 0: %d", ret);
		goto failed;
	}

	vring_rsc = rsc_table_get_vring1(rsc_table);
	ret = rproc_virtio_init_vring(vdev, 1, vring_rsc->notifyid,
				      (void *)vring_rsc->da, rsc_io,
				      vring_rsc->num, vring_rsc->align);
	if (ret) {
		LOG_ERR("failed to init vring 1: %d", ret);
		goto failed;
	}

	rpmsg_virtio_init_shm_pool(&shpool, NULL, SHM_SIZE);
	ret = rpmsg_init_vdev(&rvdev, vdev, new_service_cb, shm_io, &shpool);
	if (ret) {
		LOG_ERR("rpmsg_init_vdev failed: %d", ret);
		goto failed;
	}

	return rpmsg_virtio_get_rpmsg_device(&rvdev);

failed:
	rproc_virtio_remove_vdev(vdev);
	return NULL;
}

void rpmsg_mng_task(void *arg1, void *arg2, void *arg3)
{
	ARG_UNUSED(arg1);
	ARG_UNUSED(arg2);
	ARG_UNUSED(arg3);

	printk("PVCM RPMsg init starting\n");

	if (platform_init()) {
		LOG_ERR("platform_init failed");
		return;
	}

	rpdev = platform_create_rpmsg_vdev();
	if (!rpdev) {
		LOG_ERR("create_rpmsg_vdev failed");
		return;
	}

	/* Channel 0: debug shell over RPMsg */
	extern struct shell_transport shell_transport_rpmsg;
	int ret = shell_rpmsg_set_rpdev(&shell_transport_rpmsg, rpdev);
	if (ret) {
		LOG_ERR("shell_rpmsg_set_rpdev failed: %d", ret);
	}

	/* Channel 1: PVCM protocol — uses pvcm_rpmsg_rx_cb from transport */
	ret = rpmsg_create_ept(&proto_ept, rpdev, "rpmsg-tty",
			       RPMSG_ADDR_ANY, RPMSG_ADDR_ANY,
			       pvcm_rpmsg_rx_cb, NULL);
	if (ret) {
		LOG_ERR("failed to create protocol endpoint: %d", ret);
	} else {
		pvcm_rpmsg_set_endpoint(&proto_ept);
		printk("PVCM protocol channel ready\n");
	}

	printk("PVCM RPMsg ready — entering receive loop\n");
	while (1) {
		receive_message();
	}
}

#endif /* CONFIG_OPENAMP */

#ifdef CONFIG_PANTAVISOR_BRIDGE
/*
 * MCU HTTP server handler — serves sensor data to Linux containers.
 * Linux sends: curl http://localhost:18081/sensor
 * pvcm-run forwards to MCU, MCU responds with JSON.
 */
static void sensor_handler(uint8_t stream_id, uint8_t method,
			   const char *path, const char *headers,
			   const char *body, size_t body_len, void *ctx)
{
	printk("[mcu-server] method=%d path=%s\n", method, path);
	uint8_t sid = stream_id;

	if (method == PVCM_HTTP_GET) {
		const char *resp =
			"{\"temperature\":22.4,\"humidity\":65,\"uptime_ms\":"
			;
		char full_resp[128];
		snprintf(full_resp, sizeof(full_resp),
			 "%s%u}", resp, (unsigned)k_uptime_get_32());
		pvcm_http_respond(sid, 200,
				  "Content-Type: application/json\r\n",
				  full_resp, strlen(full_resp));
	} else {
		const char *resp = "{\"ok\":true}";
		pvcm_http_respond(sid, 200,
				  "Content-Type: application/json\r\n",
				  resp, strlen(resp));
	}
}
#endif /* CONFIG_PANTAVISOR_BRIDGE */

#ifdef CONFIG_PANTAVISOR_DBUS
/* D-Bus gateway: shell commands provide interactive testing
 * (pv dbus call, pv dbus list, pv dbus subscribe) */
#endif /* CONFIG_PANTAVISOR_DBUS */

int main(void)
{
	printk("PVCM Shell starting\n");

#ifdef CONFIG_PANTAVISOR_BRIDGE
	pvcm_http_serve("/sensor", sensor_handler, NULL);
	printk("MCU HTTP server: /sensor registered\n");
#endif

#ifdef CONFIG_PANTAVISOR_DBUS
	printk("MCU D-Bus gateway enabled\n");
#endif

#ifdef CONFIG_PANTAVISOR_FS
	printk("MCU filesystem gateway enabled\n");
	/* Mount deferred — needs transport ready (after handshake).
	 * Use pvcm_fs_mount() from app code or a delayed work item. */
#endif

#ifdef CONFIG_OPENAMP
	/* RPMsg platform: start management thread for OpenAMP vring polling */
	k_thread_create(&thread_mng_data, thread_mng_stack, APP_TASK_STACK_SIZE,
			rpmsg_mng_task,
			NULL, NULL, NULL, K_PRIO_COOP(8), 0, K_NO_WAIT);
#else
	/* native_sim / UART: PVCM server thread auto-starts via K_THREAD_DEFINE */
	printk("PVCM UART mode — server thread auto-started\n");
#endif

	return 0;
}
```

## src/shell_rpmsg.c
```c
/*
 * RPMsg shell transport backend.
 *
 * Creates a "rpmsg-tty" endpoint for the Zephyr shell. Linux sees
 * this as /dev/ttyRPMSGN — open it to get an interactive shell
 * on the MCU.
 *
 * SPDX-License-Identifier: Apache-2.0
 */

#include "shell_rpmsg.h"
#include <string.h>
#include <zephyr/logging/log.h>

LOG_MODULE_REGISTER(shell_rpmsg, LOG_LEVEL_DBG);

SHELL_RPMSG_DEFINE(shell_transport_rpmsg);
SHELL_DEFINE(shell_rpmsg_instance, "mcu:~$ ", &shell_transport_rpmsg,
	     4, 100, SHELL_FLAG_OLF_CRLF);

static bool shell_initialized;

static int rpmsg_shell_rx_cb(struct rpmsg_endpoint *ept, void *data,
			     size_t len, uint32_t src, void *priv)
{
	struct shell_rpmsg *sh = priv;

	/*
	 * First RX means Linux has bound the endpoint and set dest_addr.
	 * Now it's safe to init the shell (which writes the prompt).
	 */
	if (!shell_initialized) {
		shell_initialized = true;
		static const struct shell_backend_config_flags cfg_flags =
			SHELL_DEFAULT_BACKEND_CONFIG_FLAGS;
		shell_init(&shell_rpmsg_instance, NULL, cfg_flags, false, 0);
	}

	if (len > SHELL_RPMSG_RX_BUF_SIZE) {
		len = SHELL_RPMSG_RX_BUF_SIZE;
	}

	memcpy(sh->rx_buf, data, len);
	sh->rx_len = len;
	sh->rx_pos = 0;

	if (sh->handler) {
		sh->handler(SHELL_TRANSPORT_EVT_RX_RDY, sh->context);
	}

	return RPMSG_SUCCESS;
}

int shell_rpmsg_set_rpdev(struct shell_transport *transport,
			  struct rpmsg_device *rpdev)
{
	struct shell_rpmsg *sh = transport->ctx;
	int ret;

	sh->rpdev = rpdev;

	ret = rpmsg_create_ept(&sh->ept, rpdev, "rpmsg-tty",
			       RPMSG_ADDR_ANY, RPMSG_ADDR_ANY,
			       rpmsg_shell_rx_cb, NULL);
	if (ret) {
		LOG_ERR("failed to create shell rpmsg endpoint: %d", ret);
		return ret;
	}

	sh->ept.priv = sh;
	sh->ready = true;

	LOG_INF("shell rpmsg endpoint ready addr=0x%04x", sh->ept.addr);

	/* shell_init is deferred to first RX — Linux must bind first
	 * so dest_addr is set before the shell writes its prompt. */

	return 0;
}

static int init(const struct shell_transport *transport,
		const void *config,
		shell_transport_handler_t evt_handler,
		void *context)
{
	struct shell_rpmsg *sh = (struct shell_rpmsg *)transport->ctx;

	sh->handler = evt_handler;
	sh->context = context;
	sh->rx_len = 0;
	sh->rx_pos = 0;

	return 0;
}

static int uninit(const struct shell_transport *transport)
{
	struct shell_rpmsg *sh = (struct shell_rpmsg *)transport->ctx;

	if (sh->ready) {
		rpmsg_destroy_ept(&sh->ept);
		sh->ready = false;
	}

	return 0;
}

static int enable(const struct shell_transport *transport, bool blocking_tx)
{
	return 0;
}

static int shell_write(const struct shell_transport *transport,
		       const void *data, size_t length, size_t *cnt)
{
	struct shell_rpmsg *sh = (struct shell_rpmsg *)transport->ctx;

	if (!sh->ready) {
		*cnt = 0;
		return -ENODEV;
	}

	int ret = rpmsg_send(&sh->ept, data, length);
	if (ret < 0) {
		*cnt = 0;
		return ret;
	}

	*cnt = length;

	sh->handler(SHELL_TRANSPORT_EVT_TX_RDY, sh->context);

	return 0;
}

static int shell_read(const struct shell_transport *transport,
		      void *data, size_t length, size_t *cnt)
{
	struct shell_rpmsg *sh = (struct shell_rpmsg *)transport->ctx;

	if (sh->rx_pos < sh->rx_len) {
		size_t avail = sh->rx_len - sh->rx_pos;
		size_t to_copy = (avail < length) ? avail : length;

		memcpy(data, &sh->rx_buf[sh->rx_pos], to_copy);
		sh->rx_pos += to_copy;
		*cnt = to_copy;
	} else {
		*cnt = 0;
	}

	return 0;
}

const struct shell_transport_api shell_rpmsg_transport_api = {
	.init = init,
	.uninit = uninit,
	.enable = enable,
	.write = shell_write,
	.read = shell_read,
};

const struct shell *shell_backend_rpmsg_get_ptr(void)
{
	return &shell_rpmsg_instance;
}

/* shell_init is called from shell_rpmsg_set_rpdev() after the
 * RPMsg endpoint is created. No SYS_INIT needed. */
```

## src/shell_rpmsg.h
```c
/*
 * RPMsg shell transport backend.
 *
 * Bridges the Zephyr shell to a dedicated RPMsg endpoint so Linux
 * can interact with the MCU shell via /dev/ttyRPMSGN.
 *
 * SPDX-License-Identifier: Apache-2.0
 */

#ifndef SHELL_RPMSG_H__
#define SHELL_RPMSG_H__

#include <zephyr/shell/shell.h>
#include <openamp/open_amp.h>

#ifdef __cplusplus
extern "C" {
#endif

extern const struct shell_transport_api shell_rpmsg_transport_api;

#define SHELL_RPMSG_RX_BUF_SIZE 256

struct shell_rpmsg {
	shell_transport_handler_t handler;
	void *context;
	struct rpmsg_endpoint ept;
	struct rpmsg_device *rpdev;
	struct k_sem rx_sem;
	uint8_t rx_buf[SHELL_RPMSG_RX_BUF_SIZE];
	size_t rx_len;
	size_t rx_pos;
	bool ready;
};

#define SHELL_RPMSG_DEFINE(_name)				\
	static struct shell_rpmsg _name##_shell_rpmsg;		\
	struct shell_transport _name = {			\
		.api = &shell_rpmsg_transport_api,		\
		.ctx = (struct shell_rpmsg *)&_name##_shell_rpmsg \
	}

/**
 * @brief Set the RPMsg device for the shell backend.
 *
 * Must be called after the RPMsg vdev is created and before
 * the shell is initialized. Creates the endpoint.
 */
int shell_rpmsg_set_rpdev(struct shell_transport *transport,
			  struct rpmsg_device *rpdev);

const struct shell *shell_backend_rpmsg_get_ptr(void);

#ifdef __cplusplus
}
#endif

#endif /* SHELL_RPMSG_H__ */
```
