/*
 * Copyright (c) 2024-2026 Pantacor Ltd.
 * SPDX-License-Identifier: Apache-2.0
 *
 * i.MX8M Nano M7 pinctrl — same IOMUXC IP as i.MX8M Mini.
 */

#include <nxp/nxp_imx/mimx8mn6dvtjz-pinctrl.dtsi>

/* Override pinctrl compatible — i.MX8MN uses imx8m, not imx8mp */
&pinctrl {
	compatible = "nxp,imx8m-pinctrl";
};

&pinctrl {
	uart4_default: uart4_default {
		group0 {
			pinmux = <&iomuxc_uart4_rxd_uart_rx_uart4_rx>,
				<&iomuxc_uart4_txd_uart_tx_uart4_tx>;
			slew-rate = "fast";
			drive-strength = "40-ohm";
		};
	};
};
